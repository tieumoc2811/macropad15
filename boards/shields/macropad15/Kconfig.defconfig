## boards/shields/macropad15/Kconfig.defconfig
```kconfig
if SHIELD_MACROPAD15

config ZMK_KEYBOARD_NAME
	default "Macropad15"

# Encoder EC11 (3 nut xoay)
config EC11
	default y

endif
```

## dts/bindings/behaviors/zmk,behavior-layer-cycle.yaml
```yaml
description: Chuyen lan luot qua danh sach layer, moi lan bam sang layer ke tiep

compatible: "zmk,behavior-layer-cycle"

include: zero_param.yaml

properties:
  cycle-layers:
    type: array
    required: true
    description: |
      Danh sach layer (theo ID) se duoc xoay vong. Phan tu dau tien la layer mac dinh
      (luon bat), cac layer con lai duoc bat lan luot. Layer khong nam trong danh sach
      (vi du layer FN giu phim) khong bi anh huong.
```

## dts/bindings/behaviors/zmk,behavior-multitap.yaml
```yaml
description: Nhap ky tu kieu Nokia (multi-tap), ky tu hien ngay khi bam

compatible: "zmk,behavior-multitap"

include: zero_param.yaml

properties:
  keys:
    type: array
    required: true
    description: Danh sach keycode luan phien nhau moi lan bam lien tiep cung phim.
  tapping-term-ms:
    type: int
    default: 600
    description: Thoi gian toi da (ms) giua 2 lan bam de coi la bam tiep cung phim.
```
